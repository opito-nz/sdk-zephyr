/*
 * Copyright (c) 2024 Opito
 *
 * SPDX-License-Identifier: Apache-2.0
 */

#include <st/u5/stm32u5.dtsi>


/ {
	soc {
		/* USB-C PD is not available on this part. */
		/delete-node/ ucpd@4000dc00;

		compatible = "st,stm32u545", "st,stm32u5", "simple-bus";
	};
};
